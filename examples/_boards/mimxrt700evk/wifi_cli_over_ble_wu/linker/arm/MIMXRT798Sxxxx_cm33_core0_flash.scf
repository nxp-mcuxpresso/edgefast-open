#!armclang --target=arm-arm-none-eabi -march=armv8-m.main -E -x c
/*
** ###################################################################
**     Processors:          MIMXRT798SGAWAR_cm33_core0
**                          MIMXRT798SGFOA_cm33_core0
**
**     Compiler:            Keil ARM C/C++ Compiler
**     Reference manual:    iMXRT700RM Rev.1, 08/2022
**     Version:             rev. 1.0, 2023-11-14
**     Build:               b240227
**
**     Abstract:
**         Linker file for the Keil ARM C/C++ Compiler
**
**     Copyright 2016 Freescale Semiconductor, Inc.
**     Copyright 2016-2024 NXP
**     SPDX-License-Identifier: BSD-3-Clause
**
**     http:                 www.nxp.com
**     mail:                 support@nxp.com
**
** ###################################################################
*/

/* Sizes */
#if (defined(__stack_size__))
  #define Stack_Size                   __stack_size__
#else
  #define Stack_Size                   0x1000
#endif

#if (defined(__heap_size__))
  #define Heap_Size                    __heap_size__
#else
  #define Heap_Size                    0x1000
#endif

#define _bt_conn_cb_list_start Load$$ER_bt_conn_cb$$Base
#define _bt_conn_cb_list_end Load$$ER_bt_conn_cb$$Limit

#define _bt_sco_conn_cb_list_start Load$$ER_bt_sco_conn_cb$$Base
#define _bt_sco_conn_cb_list_end Load$$ER_bt_sco_conn_cb$$Limit

#define _bt_sco_hci_cb_list_start Load$$ER_bt_sco_hci_cb$$Base
#define _bt_sco_hci_cb_list_end Load$$ER_bt_sco_hci_cb$$Limit

#define _bt_ias_cb_list_start Load$$ER_bt_ias_cb$$Base
#define _bt_ias_cb_list_end Load$$ER_bt_ias_cb$$Limit

#define _bt_gatt_service_static_list_start Load$$ER_bt_gatt_service_static$$Base
#define _bt_gatt_service_static_list_end Load$$ER_bt_gatt_service_static$$Limit

#define _bt_settings_static_list_start Load$$ER_bt_settings_static$$Base
#define _bt_settings_static_list_end Load$$ER_bt_settings_static$$Limit

#define _settings_handler_static_list_start Load$$ER_settings_handler_static$$Base
#define _settings_handler_static_list_end Load$$ER_settings_handler_static$$Limit

#define _bt_l2cap_fixed_chan_list_start Load$$ER_bt_l2cap_fixed_chan$$Base
#define _bt_l2cap_fixed_chan_list_end Load$$ER_bt_l2cap_fixed_chan$$Limit

#define _bt_l2cap_br_fixed_chan_list_start Load$$ER_bt_l2cap_br_fixed_chan$$Base
#define _bt_l2cap_br_fixed_chan_list_end Load$$ER_bt_l2cap_br_fixed_chan$$Limit

#define _bt_hci_driver_api_list_start Load$$ER_bt_hci_driver_api$$Base
#define _bt_hci_driver_api_list_end Load$$ER_bt_hci_driver_api$$Limit
#define _bt_hci_driver_api_ext_end Load$$ER_bt_hci_driver_api$$Limit

#define _net_buf_pool_list_start Image$$RW_net_buf_pool$$Base
#define _net_buf_pool_list_end Image$$RW_net_buf_pool$$Limit

#define _k_mem_slab_list_start Image$$RW_k_mem_slab$$Base
#define _k_mem_slab_list_end Image$$RW_k_mem_slab$$Limit

#define __shell_command_list_start Image$$RW__shell_command$$Base
#define __shell_command_list_end Image$$RW__shell_command$$Limit

#define __init_PRE_KERNEL_1_start Load$$ER_z_init_PRE_KERNEL_1$$Base
#define __init_PRE_KERNEL_2_start Load$$ER_z_init_PRE_KERNEL_2$$Base
#define __init_POST_KERNEL_start Load$$ER_z_init_POST_KERNEL$$Base
#define __init_APPLICATION_start Load$$ER_z_init_APPLICATION$$Base
#define __init_start Load$$ER_z_init_PRE_KERNEL_1$$Base
#define __init_end Load$$ER_z_init_APPLICATION$$Limit

/* The SRAM region [0x000000-0x013FFF] is reserved for ROM bootloader execution. Can be reused after boot. */
/* The SRAM region [0x014000-0x07FFFF] is reserved for Non-cached shared memory or application data. */
/* The SRAM region [0x080000-0x3FFFFF] is reserved for CPU0 application, last 2MB non-cacheable data for NPU/GPU/Display etc. */
/* The SRAM region [0x400000-0x57FFFF] is reserved for HiFi4 application. */

#if (defined(__ram_vector_table__))
  #define __ram_vector_table_size__    0x00000300
#else
  #define __ram_vector_table_size__    0x00000000
#endif

#define LITTLEFS_REGION_SIZE           0x00200000

#define  m_interrupts_start            0x28004000
#define  m_interrupts_size             0x00000300

#define  m_text_start                  0x28004300
#define  m_text_size                   0x007FBD00 - LITTLEFS_REGION_SIZE

#define  m_core1_image_maximum_size    0x00080000

#define m_interrupts_ram_start         0x20080000
#define m_interrupts_ram_size          __ram_vector_table_size__

#define  m_data_start                  (m_interrupts_ram_start + m_interrupts_ram_size)
#define  m_data_size                   (0x00180000 - m_interrupts_ram_size)

#define  m_boot_flash_conf_start       0x28000000

#if (defined(__use_shmem__))
  #define rpmsg_sh_mem_start           0x20200000
  #define m_rpmsg_sh_mem_size          0x00002000
  #define m_ncache_start               0x20202000
  #define m_ncache_size                0x001FD000
#else
  #define m_ncache_start               0x20200000
  #define m_ncache_size                0x00200000
#endif

/* NOTE: The last LITTLEFS_REGION_SIZE Flash( in range (m_text_start + m_text_size) ~ (m_text_start + m_text_size + LITTLEFS_REGION_SIZE -1)) is reserved for litteFS data */

/*** littleFS configuration Start ***/
#define EDGEFAST_BT_LITTLEFS_STORAGE_START_ADDRESS  (m_text_start + m_text_size)
#define EDGEFAST_BT_LITTLEFS_STORAGE_SECTOR_SIZE    (0x1000)    /* 4k flash sector size */
#define EDGEFAST_BT_LITTLEFS_STORAGE_MAX_SECTORS    (LITTLEFS_REGION_SIZE / EDGEFAST_BT_LITTLEFS_STORAGE_SECTOR_SIZE)
/*** littleFS configuration End ***/

LR_m_flash_conf m_boot_flash_conf_start m_interrupts_start-m_boot_flash_conf_start {
  FLASH_CONFIG m_boot_flash_conf_start m_interrupts_start-m_boot_flash_conf_start{ ; load address = execution address
    * (.flash_conf)
  }
}

LR_m_interrupts m_interrupts_start m_text_start+m_text_size-m_interrupts_start {
  VECTOR_ROM m_interrupts_start FIXED m_interrupts_size { ; load address = execution address
    * (.isr_vector,+FIRST)
  }

  ER_m_text m_text_start FIXED m_text_size { ; load address = execution address
    * (InRoot$$Sections)
    .ANY (+RO)
  }

  ER_z_init_PRE_KERNEL_1 +0 { ;
    * (.z_init_PRE_KERNEL_1_P_?_*)
    * (.z_init_PRE_KERNEL_1_P_??_*)
    * (.z_init_PRE_KERNEL_1_P_???_*)
  }

  ER_z_init_PRE_KERNEL_2 +0 { ;
    * (.z_init_PRE_KERNEL_2_P_?_*)
    * (.z_init_PRE_KERNEL_2_P_??_*)
    * (.z_init_PRE_KERNEL_2_P_???_*)
  }

  ER_z_init_POST_KERNEL +0 { ;
    * (.z_init_POST_KERNEL_P_?_*)
    * (.z_init_POST_KERNEL_P_??_*)
    * (.z_init_POST_KERNEL_P_???_*)
  }

  ER_z_init_APPLICATION +0 { ;
    * (.z_init_APPLICATION_P_?_*)
    * (.z_init_APPLICATION_P_??_*)
    * (.z_init_APPLICATION_P_???_*)
  }

  ER_bt_conn_cb +0 { ;
    * (._bt_conn_cb*)
  }

  ER_bt_sco_conn_cb +0 { ;
    * (._bt_sco_conn_cb*)
  }

  ER_bt_sco_hci_cb +0 { ;
    * (._bt_sco_hci_cb*)
  }

  ER_bt_ias_cb +0 { ;
    * (._bt_ias_cb*)
  }

  ER_bt_gatt_service_static +0 { ;
    * (._bt_gatt_service_static*)
  }

  ER_bt_settings_static +0 { ;
    * (._bt_settings*)
  }

  ER_settings_handler_static +0 { ;
    * (._settings_handler_static*)
  }

  ER_bt_l2cap_fixed_chan +0 { ;
    * (._bt_l2cap_fixed_chan*)
  }

  ER_bt_l2cap_br_fixed_chan +0 { ;
    * (._bt_l2cap_br_fixed_chan*)
  }

  ER_bt_hci_driver_api +0 { ;
    * (._bt_hci_driver_api*)
  }

  EDGEFAST_BT_LittleFS_region EDGEFAST_BT_LITTLEFS_STORAGE_START_ADDRESS EMPTY (LITTLEFS_REGION_SIZE) { ; load address = execution address
  }

  CORE1_REGION +0 ALIGN 16 m_core1_image_maximum_size {
    .ANY (.core1_code)
  }
#if (defined(__ram_vector_table__))
  VECTOR_RAM m_interrupts_ram_start EMPTY m_interrupts_ram_size {
  }
#else
  VECTOR_RAM m_interrupts_start EMPTY 0 {
  }
#endif

#if (defined(__heap_noncacheable__))
  RW_m_data m_data_start ALIGN 4 m_data_size-Stack_Size { ; RW data
#else
  RW_m_data m_data_start ALIGN 4 m_data_size-Stack_Size-Heap_Size { ; RW data
#endif
    fsl_xspi.o (+RO +RW +ZI)
    mflash_drv.o (+RO +RW +ZI)
    * (.ramfunc)
    * (CodeQuickAccess)
    * (DataQuickAccess)
    .ANY (+RW +ZI)
  }
#if (!defined(__heap_noncacheable__))
  ARM_LIB_HEAP +0 EMPTY Heap_Size {    ; Heap region growing up
  }
#endif
  ARM_LIB_STACK m_data_start+m_data_size EMPTY -Stack_Size { ; Stack region growing down
  }
#if (defined(__heap_noncacheable__))
  RW_m_ncache m_ncache_start m_ncache_size - Heap_Size { ; ncache data
#else
  RW_m_ncache m_ncache_start m_ncache_size { ; ncache data
#endif
    * (NonCacheable.init)
    * (*NonCacheable)
  }
#if (defined(__heap_noncacheable__))
  ARM_LIB_HEAP +0 EMPTY Heap_Size {    ; Heap region growing up
  }
  RW_m_ncache_unused +0 EMPTY m_ncache_size-ImageLength(RW_m_ncache)-Heap_Size { ; Empty region added for MPU configuration
  }
#else
  RW_m_ncache_unused +0 EMPTY m_ncache_size-ImageLength(RW_m_ncache) { ; Empty region added for MPU configuration
  }
#endif

#if (defined(__use_shmem__))
  RPMSG_SH_MEM m_rpmsg_sh_mem_start UNINIT m_rpmsg_sh_mem_size { ; Shared memory used by RPMSG
  * (rpmsg_sh_mem_section)
  }
  RPMSG_SH_MEM_unused +0 EMPTY m_rpmsg_sh_mem_size-ImageLength(RPMSG_SH_MEM) { ; Empty region added for MPU configuration
  }
#endif

  RW_m_usb_data +0 ALIGNALL 32 { ; USB RW data
    * (*CacheLineData.init)
    * (*CacheLineData)
  }
  ; Other regions shall not be placed between RW_m_usb_data and RW_m_usb_data_aux
  RW_m_usb_data_aux +0 ALIGN 32 EMPTY 0 { ; Empty region added for cache line alignment.
  }

  RW_net_buf_pool +0 { ;
    * (._net_buf_pool*)
  }

  RW_k_mem_slab +0 { ;
    * (._k_mem_slab*)
  }

  RW__shell_command +0 { ;
    * (.__shell_command*)
  }
}
