#!armclang --target=arm-arm-none-eabi -march=armv8-m.main -E -x c
/*
** ###################################################################
**     Processors:          RW612ETA2I
**                          RW612HNA2I
**                          RW612UKA2I
**
**     Compiler:            Keil ARM C/C++ Compiler
**     Reference manual:    MIMXRW685 User manual Rev. 0.95 11 November 2019
**     Version:             rev. 1.0, 2021-03-16
**     Build:               b220521
**
**     Abstract:
**         Linker file for the Keil ARM C/C++ Compiler
**
**     Copyright 2016 Freescale Semiconductor, Inc.
**     Copyright 2016-2024 NXP
**     All rights reserved.
**
**     SPDX-License-Identifier: BSD-3-Clause
**
**     http:                 www.nxp.com
**     mail:                 support@nxp.com
**
** ###################################################################
*/

/* Sizes */
#if (defined(__stack_size__))
  #define Stack_Size                   __stack_size__
#else
  #define Stack_Size                   0x0400
#endif

#if (defined(__heap_size__))
  #define Heap_Size                    __heap_size__
#else
  #define Heap_Size                    0x0400
#endif

#define _bt_conn_cb_list_start Load$$ER_bt_conn_cb$$Base
#define _bt_conn_cb_list_end Load$$ER_bt_conn_cb$$Limit

#define _bt_sco_conn_cb_list_start Load$$ER_bt_sco_conn_cb$$Base
#define _bt_sco_conn_cb_list_end Load$$ER_bt_sco_conn_cb$$Limit

#define _bt_sco_hci_cb_list_start Load$$ER_bt_sco_hci_cb$$Base
#define _bt_sco_hci_cb_list_end Load$$ER_bt_sco_hci_cb$$Limit

#define _bt_ias_cb_list_start Load$$ER_bt_ias_cb$$Base
#define _bt_ias_cb_list_end Load$$ER_bt_ias_cb$$Limit

#define _bt_gatt_service_static_list_start Load$$ER_bt_gatt_service_static$$Base
#define _bt_gatt_service_static_list_end Load$$ER_bt_gatt_service_static$$Limit

#define _bt_settings_static_list_start Load$$ER_bt_settings_static$$Base
#define _bt_settings_static_list_end Load$$ER_bt_settings_static$$Limit

#define _settings_handler_static_list_start Load$$ER_settings_handler_static$$Base
#define _settings_handler_static_list_end Load$$ER_settings_handler_static$$Limit

#define _bt_l2cap_fixed_chan_list_start Load$$ER_bt_l2cap_fixed_chan$$Base
#define _bt_l2cap_fixed_chan_list_end Load$$ER_bt_l2cap_fixed_chan$$Limit

#define _bt_l2cap_br_fixed_chan_list_start Load$$ER_bt_l2cap_br_fixed_chan$$Base
#define _bt_l2cap_br_fixed_chan_list_end Load$$ER_bt_l2cap_br_fixed_chan$$Limit

#define _bt_hci_driver_api_list_start Load$$ER_bt_hci_driver_api$$Base
#define _bt_hci_driver_api_list_end Load$$ER_bt_hci_driver_api$$Limit
#define _bt_hci_driver_api_ext_end Load$$ER_bt_hci_driver_api$$Limit

#define _net_buf_pool_list_start Image$$RW_net_buf_pool$$Base
#define _net_buf_pool_list_end Image$$RW_net_buf_pool$$Limit

#define _k_mem_slab_list_start Image$$RW_k_mem_slab$$Base
#define _k_mem_slab_list_end Image$$RW_k_mem_slab$$Limit

#define __shell_command_list_start Image$$RW__shell_command$$Base
#define __shell_command_list_end Image$$RW__shell_command$$Limit

#define __init_PRE_KERNEL_1_start Load$$ER_z_init_PRE_KERNEL_1$$Base
#define __init_PRE_KERNEL_2_start Load$$ER_z_init_PRE_KERNEL_2$$Base
#define __init_POST_KERNEL_start Load$$ER_z_init_POST_KERNEL$$Base
#define __init_APPLICATION_start Load$$ER_z_init_APPLICATION$$Base
#define __init_start Load$$ER_z_init_PRE_KERNEL_1$$Base
#define __init_end Load$$ER_z_init_APPLICATION$$Limit

#if (defined(__ram_vector_table__))
  #define __ram_vector_table_size__    0x00000400
#else
  #define __ram_vector_table_size__    0x00000000
#endif

#define LITTLEFS_REGION_SIZE           0x00200000

#define  m_interrupts_start            0x08001000
#define  m_interrupts_size             0x00000400

#define  m_text_start                  0x08001400
#define  m_text_size                   0x03FFEC00 - LITTLEFS_REGION_SIZE

#define m_interrupts_ram_start         0x20000000
#define m_interrupts_ram_size          __ram_vector_table_size__

#define  m_data_start                  (m_interrupts_ram_start + m_interrupts_ram_size)
#define  m_data_size                   (0x00130000 - m_interrupts_ram_size)

/* NOTE: The last LITTLEFS_REGION_SIZE Flash( in range (m_text_start + m_text_size) ~ (m_text_start + m_text_size + LITTLEFS_REGION_SIZE -1)) is reserved for litteFS data */

/*** littleFS configuration Start ***/
#define EDGEFAST_BT_LITTLEFS_STORAGE_START_ADDRESS  (m_text_start + m_text_size)
#define EDGEFAST_BT_LITTLEFS_STORAGE_SECTOR_SIZE    (0x1000)    /* 4k flash sector size */
#define EDGEFAST_BT_LITTLEFS_STORAGE_MAX_SECTORS    (LITTLEFS_REGION_SIZE / EDGEFAST_BT_LITTLEFS_STORAGE_SECTOR_SIZE)
/*** littleFS configuration End ***/

#define m_flash_start                  0x08000000
#define m_mbox13_start                 0x41380000
#define m_mbox13_size                  0x00000488

#define m_txq31_start                  0x41380488
#define m_txq31_size                   0x00001000

#define m_mbox23_start                 0x443C0000
#define m_mbox23_size                  0x00000488

#define m_txq23_start                  0x443C0488
#define m_txq23_size                   0x00001080

#define m_txq32_start                  0x443C1508
#define m_txq32_size                   0x00001080

LR_m_flash_conf m_flash_start m_interrupts_start-m_flash_start {
  FLASH_CONFIG +0 { ; load address = execution address
    * (.flash_conf)
  }
}

LR_m_interrupts m_interrupts_start m_text_start+m_text_size-m_interrupts_start {
  VECTOR_ROM m_interrupts_start FIXED m_interrupts_size { ; load address = execution address
    * (.isr_vector,+FIRST)
  }

  ER_m_text m_text_start FIXED m_text_size { ; load address = execution address
    .ANY (+RO)
  }

  ER_z_init_PRE_KERNEL_1 +0 { ;
    * (.z_init_PRE_KERNEL_1_P_?_*)
    * (.z_init_PRE_KERNEL_1_P_??_*)
    * (.z_init_PRE_KERNEL_1_P_???_*)
  }

  ER_z_init_PRE_KERNEL_2 +0 { ;
    * (.z_init_PRE_KERNEL_2_P_?_*)
    * (.z_init_PRE_KERNEL_2_P_??_*)
    * (.z_init_PRE_KERNEL_2_P_???_*)
  }

  ER_z_init_POST_KERNEL +0 { ;
    * (.z_init_POST_KERNEL_P_?_*)
    * (.z_init_POST_KERNEL_P_??_*)
    * (.z_init_POST_KERNEL_P_???_*)
  }

  ER_z_init_APPLICATION +0 { ;
    * (.z_init_APPLICATION_P_?_*)
    * (.z_init_APPLICATION_P_??_*)
    * (.z_init_APPLICATION_P_???_*)
  }

  ER_bt_conn_cb +0 { ;
    * (._bt_conn_cb*)
  }

  ER_bt_sco_conn_cb +0 { ;
    * (._bt_sco_conn_cb*)
  }

  ER_bt_sco_hci_cb +0 { ;
    * (._bt_sco_hci_cb*)
  }

  ER_bt_ias_cb +0 { ;
    * (._bt_ias_cb*)
  }

  ER_bt_gatt_service_static +0 { ;
    * (._bt_gatt_service_static*)
  }

  ER_bt_settings_static +0 { ;
    * (._bt_settings*)
  }

  ER_settings_handler_static +0 { ;
    * (._settings_handler_static*)
  }

  ER_bt_l2cap_fixed_chan +0 { ;
    * (._bt_l2cap_fixed_chan*)
  }

  ER_bt_l2cap_br_fixed_chan +0 { ;
    * (._bt_l2cap_br_fixed_chan*)
  }

  ER_bt_hci_driver_api +0 { ;
    * (._bt_hci_driver_api*)
  }

  EDGEFAST_BT_LittleFS_region EDGEFAST_BT_LITTLEFS_STORAGE_START_ADDRESS EMPTY (LITTLEFS_REGION_SIZE) { ; load address = execution address
  }

#if (defined(__ram_vector_table__))
  VECTOR_RAM m_interrupts_ram_start EMPTY m_interrupts_ram_size {
  }
#else
  VECTOR_RAM m_interrupts_start EMPTY 0 {
  }
#endif

  RW_m_data m_data_start ALIGN 4 m_data_size-Stack_Size-Heap_Size { ; RW data
    * (CodeQuickAccess)
    * (DataQuickAccess)
    .ANY (+RW +ZI)
    * (.ramfunc)
    /* Necessary to run flash routines from SRAM */
    fsl_adapter_flexspi_nor_flash.o (+RO +RW +ZI)
    fsl_flexspi.o (+RO +RW +ZI)
    mflash_drv.o (+RO +RW +ZI)
    * (NonCacheable.init)
    * (*NonCacheable)
  }

  RW_net_buf_pool +0 { ;
    * (._net_buf_pool*)
  }

  RW_k_mem_slab +0 { ;
    * (._k_mem_slab*)
  }

  RW__shell_command +0 { ;
    * (.__shell_command*)
  }

  ARM_LIB_HEAP +0 EMPTY Heap_Size {    ; Heap region growing up
  }
  ARM_LIB_STACK m_data_start+m_data_size EMPTY -Stack_Size { ; Stack region growing down
  }

  RW_smu_cpu13_mbox m_mbox13_start ALIGN 4 m_mbox13_size {
    * (.smu_cpu13_mbox)
  }

  RW_smu_cpu31_txq m_txq31_start ALIGN 4 m_txq31_size {
    * (.smu_cpu31_txq)
  }

  RW_smu_cpu23_mbox m_mbox23_start ALIGN 4 m_mbox23_size {
    * (.smu_cpu23_mbox)
  }

  RW_smu_cpu32_txq m_txq32_start ALIGN 4 m_txq32_size {
    * (.smu_cpu32_txq)
  }
}

LR_m_boot +0 {
  ER_m_boot +0 { ; load address = execution address
    * (InRoot$$Sections)
  }
}
