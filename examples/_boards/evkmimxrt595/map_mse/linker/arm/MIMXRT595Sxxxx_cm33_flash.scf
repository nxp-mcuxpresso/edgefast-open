#!armclang --target=arm-arm-none-eabi -march=armv8-m.main -E -x c
/*
** ###################################################################
**     Processors:          MIMXRT595SFAWC_cm33
**                          MIMXRT595SFFOC_cm33
**
**     Compiler:            Keil ARM C/C++ Compiler
**     Reference manual:    iMXRT500RM Rev.0, 01/2021
**     Version:             rev. 4.0, 2020-05-12
**     Build:               b210303
**
**     Abstract:
**         Linker file for the Keil ARM C/C++ Compiler
**
**     Copyright 2016 Freescale Semiconductor, Inc.
**     Copyright 2016-2021,2023 NXP
**     All rights reserved.
**
**     SPDX-License-Identifier: BSD-3-Clause
**
**     http:                 www.nxp.com
**     mail:                 support@nxp.com
**
** ###################################################################
*/

/* USB BDT size */
#define usb_bdt_size                   0x0
/* Sizes */
#if (defined(__stack_size__))
  #define Stack_Size                   __stack_size__
#else
  #define Stack_Size                   0x0400
#endif

#if (defined(__heap_size__))
  #define Heap_Size                    __heap_size__
#else
  #define Heap_Size                    0x1000
#endif

#define _bt_conn_cb_list_start Load$$ER_bt_conn_cb$$Base
#define _bt_conn_cb_list_end Load$$ER_bt_conn_cb$$Limit

#define _bt_sco_conn_cb_list_start Load$$ER_bt_sco_conn_cb$$Base
#define _bt_sco_conn_cb_list_end Load$$ER_bt_sco_conn_cb$$Limit

#define _bt_sco_hci_cb_list_start Load$$ER_bt_sco_hci_cb$$Base
#define _bt_sco_hci_cb_list_end Load$$ER_bt_sco_hci_cb$$Limit

#define _bt_ias_cb_list_start Load$$ER_bt_ias_cb$$Base
#define _bt_ias_cb_list_end Load$$ER_bt_ias_cb$$Limit

#define _bt_gatt_service_static_list_start Load$$ER_bt_gatt_service_static$$Base
#define _bt_gatt_service_static_list_end Load$$ER_bt_gatt_service_static$$Limit

#define _bt_settings_static_list_start Load$$ER_bt_settings_static$$Base
#define _bt_settings_static_list_end Load$$ER_bt_settings_static$$Limit

#define _settings_handler_static_list_start Load$$ER_settings_handler_static$$Base
#define _settings_handler_static_list_end Load$$ER_settings_handler_static$$Limit

#define _bt_l2cap_fixed_chan_list_start Load$$ER_bt_l2cap_fixed_chan$$Base
#define _bt_l2cap_fixed_chan_list_end Load$$ER_bt_l2cap_fixed_chan$$Limit

#define _bt_l2cap_br_fixed_chan_list_start Load$$ER_bt_l2cap_br_fixed_chan$$Base
#define _bt_l2cap_br_fixed_chan_list_end Load$$ER_bt_l2cap_br_fixed_chan$$Limit

#define _net_buf_pool_list_start Image$$RW_net_buf_pool$$Base
#define _net_buf_pool_list_end Image$$RW_net_buf_pool$$Limit

#define _k_mem_slab_list_start Image$$RW_k_mem_slab$$Base
#define _k_mem_slab_list_end Image$$RW_k_mem_slab$$Limit

#define __shell_command_list_start Image$$RW__shell_command$$Base
#define __shell_command_list_end Image$$RW__shell_command$$Limit

#define __init_PRE_KERNEL_1_start Load$$ER_z_init_PRE_KERNEL_1$$Base
#define __init_PRE_KERNEL_2_start Load$$ER_z_init_PRE_KERNEL_2$$Base
#define __init_POST_KERNEL_start Load$$ER_z_init_POST_KERNEL$$Base
#define __init_APPLICATION_start Load$$ER_z_init_APPLICATION$$Base
#define __init_start Load$$ER_z_init_PRE_KERNEL_1$$Base
#define __init_end Load$$ER_z_init_APPLICATION$$Limit

/* The SRAM region [0x10000-0x1BFFF] is reserved for ROM code. */
/* The SRAM region [0x0-0xFFFF], [0x1C000-0x1FFFF] are reserved for app-specific use cases. */
/* The SRAM region [0x20000-0x7FFFF] is reserved for Non-cached shared memory between M33 and DSP. */
/* The SRAM region [0x80000-0x27FFFF] is reserved for DSP code and data. */

#if (defined(__ram_vector_table__))
  #define __ram_vector_table_size__    0x00000200
#else
  #define __ram_vector_table_size__    0x00000000
#endif

#define LITTLEFS_REGION_SIZE           0x00800000

#define  m_interrupts_start            0x08001000
#define  m_interrupts_size             0x00000200

#define  m_text_start                  0x08001200
#define  m_text_size                   0x03FFEE00 - LITTLEFS_REGION_SIZE

#define m_interrupts_ram_start         0x20080000
#define m_interrupts_ram_size          __ram_vector_table_size__

#define  m_data_start                  (m_interrupts_ram_start + m_interrupts_ram_size)
#define  m_data_size                   (0x00280000 - m_interrupts_ram_size)

#define  m_usb_sram_start              0x40140000
#define  m_usb_sram_size               0x00004000

#define  m_boot_flash_conf_start       0x08000400

/* NOTE: The last LITTLEFS_REGION_SIZE Flash( in range (m_text_start + m_text_size) ~ (m_text_start + m_text_size + LITTLEFS_REGION_SIZE -1)) is reserved for litteFS data */

/*** littleFS configuration Start ***/
#define EDGEFAST_BT_LITTLEFS_STORAGE_START_ADDRESS  (m_text_start + m_text_size)
#define EDGEFAST_BT_LITTLEFS_STORAGE_SECTOR_SIZE    (0x1000)    /* 4k flash sector size */
#define EDGEFAST_BT_LITTLEFS_STORAGE_MAX_SECTORS    (LITTLEFS_REGION_SIZE / EDGEFAST_BT_LITTLEFS_STORAGE_SECTOR_SIZE)
/*** littleFS configuration End ***/

LR_m_flash_conf m_boot_flash_conf_start m_interrupts_start-m_boot_flash_conf_start {
  FLASH_CONFIG m_boot_flash_conf_start m_interrupts_start-m_boot_flash_conf_start{ ; load address = execution address
    * (.flash_conf)
  }
}

LR_m_interrupts m_interrupts_start m_text_start+m_text_size-m_interrupts_start {
  VECTOR_ROM m_interrupts_start FIXED m_interrupts_size { ; load address = execution address
    * (.isr_vector,+FIRST)
  }

  ER_m_text m_text_start FIXED m_text_size { ; load address = execution address
    * (InRoot$$Sections)
    .ANY (+RO)
  }

  ER_z_init_PRE_KERNEL_1 +0 { ;
    * (.z_init_PRE_KERNEL_1_P_?_*)
    * (.z_init_PRE_KERNEL_1_P_??_*)
    * (.z_init_PRE_KERNEL_1_P_???_*)
  }

  ER_z_init_PRE_KERNEL_2 +0 { ;
    * (.z_init_PRE_KERNEL_2_P_?_*)
    * (.z_init_PRE_KERNEL_2_P_??_*)
    * (.z_init_PRE_KERNEL_2_P_???_*)
  }

  ER_z_init_POST_KERNEL +0 { ;
    * (.z_init_POST_KERNEL_P_?_*)
    * (.z_init_POST_KERNEL_P_??_*)
    * (.z_init_POST_KERNEL_P_???_*)
  }

  ER_z_init_APPLICATION +0 { ;
    * (.z_init_APPLICATION_P_?_*)
    * (.z_init_APPLICATION_P_??_*)
    * (.z_init_APPLICATION_P_???_*)
  }

  ER_bt_conn_cb +0 { ;
    * (._bt_conn_cb*)
  }

  ER_bt_sco_conn_cb +0 { ;
    * (._bt_sco_conn_cb*)
  }

  ER_bt_sco_hci_cb +0 { ;
    * (._bt_sco_hci_cb*)
  }

  ER_bt_ias_cb +0 { ;
    * (._bt_ias_cb*)
  }

  ER_bt_gatt_service_static +0 { ;
    * (._bt_gatt_service_static*)
  }

  ER_bt_settings_static +0 { ;
    * (._bt_settings*)
  }

  ER_settings_handler_static +0 { ;
    * (._settings_handler_static*)
  }

  ER_bt_l2cap_fixed_chan +0 { ;
    * (._bt_l2cap_fixed_chan*)
  }

  ER_bt_l2cap_br_fixed_chan +0 { ;
    * (._bt_l2cap_br_fixed_chan*)
  }

  EDGEFAST_BT_LittleFS_region EDGEFAST_BT_LITTLEFS_STORAGE_START_ADDRESS EMPTY (LITTLEFS_REGION_SIZE) { ; load address = execution address
  }

#if (defined(__ram_vector_table__))
  VECTOR_RAM m_interrupts_ram_start EMPTY m_interrupts_ram_size {
  }
#else
  VECTOR_RAM m_interrupts_start EMPTY 0 {
  }
#endif

  RW_m_data m_data_start ALIGN 4 m_data_size-Stack_Size-Heap_Size { ; RW data
    * (CodeQuickAccess)
    * (DataQuickAccess)
    .ANY (+RW +ZI)
    * (.ramfunc)
    /* Necessary to run flash routines from SRAM */
    fsl_adapter_flexspi_nor_flash.o (+RO +RW +ZI)
    fsl_flexspi.o (+RO +RW +ZI)
    fsl_reset.o (+RO +RW +ZI)
    mflash_drv.o (+RO +RW +ZI)
    * (NonCacheable.init)
    * (*NonCacheable)
  }

  RW_net_buf_pool +0 { ;
    * (._net_buf_pool*)
  }

  RW_k_mem_slab +0 { ;
    * (._k_mem_slab*)
  }

  RW__shell_command +0 { ;
    * (.__shell_command*)
  }

  ARM_LIB_HEAP +0 EMPTY Heap_Size {    ; Heap region growing up
  }
  ARM_LIB_STACK m_data_start+m_data_size EMPTY -Stack_Size { ; Stack region growing down
  }

  ER_m_usb_bdt m_usb_sram_start UNINIT usb_bdt_size {
    * (*m_usb_bdt)
  }

  ER_m_usb_ram (m_usb_sram_start + usb_bdt_size) UNINIT (m_usb_sram_size - usb_bdt_size) {
    * (*m_usb_global)
  }
}
