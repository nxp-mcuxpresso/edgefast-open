## source/porting/settings/Kconfig
```kconfig
# Copyright 2025 NXP
# Copyright (c) 2018 Nordic Semiconductor ASA
# SPDX-License-Identifier: Apache-2.0

menuconfig PORT_SETTINGS
	bool "Settings"
	help
	  The settings subsystem allows its users to serialize and
	  deserialize state in memory into and from non-volatile memory.
	  It supports several back-ends to store and load serialized data from
	  and it can do so atomically for all involved modules.

if PORT_SETTINGS

choice SETTINGS_BACKEND
	prompt "Storage back-end"
	default SETTINGS_LITTLEFS
	help
	  Storage back-end to be used by the settings subsystem.

config SETTINGS_LITTLEFS
	bool "Little FS"
	select MCUX_COMPONENT_middleware.littlefs
	help
	  Use LiitleFS as settings storage backend.

if SETTINGS_LITTLEFS

choice SETTINGS_LITTLEFS_FLASH
    prompt "Local storage selection"
    default SETTINGS_LITTLEFS_FLASH_MFLASH_OFF_CHIP if MCUX_HW_BOARD_evkbimxrt1050 || \
                 MCUX_HW_BOARD_evkcmimxrt1060 || MCUX_HW_BOARD_evkmimxrt1040 || \
                 MCUX_HW_BOARD_evkmimxrt1180 || MCUX_HW_BOARD_mimxrt685audevk || \
                 MCUX_HW_BOARD_rdrw612bga || MCUX_HW_BOARD_frdmrw612 || \
                 MCUX_HW_BOARD_mimxrt700evk || MCUX_HW_BOARD_evkbmimxrt1170 || \
                 MCUX_HW_BOARD_evkmimxrt595 || MCUX_HW_BOARD_evkmimxrt685 || \
                 MCUX_HW_BOARD_frdmimxrt700
    default SETTINGS_LITTLEFS_FLASH_MFLASH_ON_CHIP_FMU if MCUX_HW_BOARD_mcxn5xxevk || \
                 MCUX_HW_BOARD_mcxn9xxevk || MCUX_HW_BOARD_frdmmcxn947
    help
      The Flash driver will be automatically selected based on board.
      It is also possible to select the flash driver manually.

config SETTINGS_LITTLEFS_FLASH_MFLASH_OFF_CHIP
    bool "off chip mflash"
    select MCUX_COMPONENT_component.mflash_offchip

config SETTINGS_LITTLEFS_FLASH_ADAPTER_RT685EVK
    bool "rt685evk flash adapter"
    select MCUX_COMPONENT_component.flexspi_nor_flash_adapter_rt685evk
    depends on MCUX_HW_BOARD_evkmimxrt685

config SETTINGS_LITTLEFS_FLASH_MFLASH_ON_CHIP_FMU
    bool "on chip mflash via FMU controller"
    select MCUX_COMPONENT_component.mflash_onchip_fmu
    depends on MCUX_HW_BOARD_mcxn5xxevk || MCUX_HW_BOARD_mcxn9xxevk || MCUX_HW_BOARD_frdmmcxn947

endchoice # SETTINGS_LITTLEFS_FLASH

endif # SETTINGS_LITTLEFS

endchoice # SETTINGS_BACKEND

endif # PORT_SETTINGS
```

## source/porting/shell/Kconfig
```kconfig
# Copyright 2025 NXP
#
# SPDX-License-Identifier: BSD-3-Clause

config PORT_SHELL
	bool
	select MCUX_COMPONENT_component.lists
	select MCUX_COMPONENT_component.common_task

if PORT_SHELL
config SHELL_ADVANCE
	bool "Enable Advanced Shell Features"
	default y
	help
	  Enable advanced shell features for enhanced command-line interaction
	  and extended functionality in the EdgeFast shell environment.
	  No prefix in generated macro

config SHELL_USE_COMMON_TASK
	bool "Shell Common Task Configuration"
	default n
	help
	  Configure the common task usage for shell operations.
	  No prefix in generated macro

config SHELL_PROMPT
	string "Shell prompt"
	default SHELL_PROMPT_UART
	help
	  Configure the prompt string for shell operations.
	  Macro value is in quotes

config SHELL_PROMPT_UART
	string
	default "uart:~$ "
	help
	  Configure the prompt UART string for shell operations.
	  Macro value is in quotes

config SHELL_BUFFER_SIZE
	int "Shell Command Buffer Size Configuration"
	range 8 65535
	default 64
	help
	  Configure the buffer size for shell cmd.
	  No prefix in generated macro

config SHELL_MAX_ARGS
	int "Shell Command Max Arguments Configuration"
	range 2 255
	default 8
	help
	  Configure the maximum number of arguments (including the command
	  name) that a shell command line can be split into.
	  No prefix in generated macro

config SHELL_ECHO_WHEN_EOF_RECEIVED
	bool "Shell Command only be echoed when an EOF is received"
	default n
	help
	  Shell Command only be echoed when an EOF is received.
	  No prefix in generated macro

config SHELL_AUTO_FLUSH
	bool "Auto flush all print message"
	default n
	help
	  Auto flush all print message.
	  No prefix in generated macro

endif # PORT_SHELL
```

## source/porting/thread/Kconfig
```kconfig
# Copyright 2026 NXP
# SPDX-License-Identifier: Apache-2.0

choice BT_THREAD_SCHEDULER_LOCK
  prompt "Enable Bluetooth Thread Scheduler Lock"
  default BT_THREAD_SCHEDULER_LOCK_VIA_HIGHEST_PRIO
  help
    Enable the Bluetooth thread scheduler lock to protect critical sections in the Bluetooth stack.
    This ensures thread-safe operations when accessing shared resources in the Bluetooth
    implementation.

  config BT_THREAD_SCHEDULER_LOCK_VIA_HIGHEST_PRIO
    bool "Set current thread with highest priority for Bluetooth Thread Scheduler Lock"
    help
      Set current thread with highest priority for Bluetooth Thread Scheduler Lock. This provides
      a simple and efficient mechanism for synchronizing access to critical sections in the
      Bluetooth stack.

  config BT_THREAD_SCHEDULER_LOCK_VIA_SCHEDULER
    bool "Use Scheduler for Bluetooth Thread Scheduler Lock"
    help
      Use the scheduler's built-in locking mechanism to implement the Bluetooth thread scheduler
      lock. This may provide better performance in certain scenarios but may not be supported on all
      platforms. But, the potential issue is the synchronize components cannot be used in Edgefast
      open Bluetooth callback, including `xQueuePeek()`, `xQueueSemaphoreTake()`, `xQueueReceive()`,
      `xQueueGenericSend()`, `xEventGroupWaitBits()`, `xEventGroupSync()`, etc.

  config BT_THREAD_SCHEDULER_LOCK_NONE
    bool "Do not use Bluetooth Thread Scheduler Lock"
    help
      Do not use any locking mechanism for the Bluetooth thread scheduler. This may lead to
      potential race conditions and is not recommended for production use.

endchoice # BT_THREAD_SCHEDULER_LOCK

config THREAD_NAME
  bool "Enable custom thread naming"
  default y
  help
    Enable support for custom thread names in the Bluetooth thread implementation.
```
