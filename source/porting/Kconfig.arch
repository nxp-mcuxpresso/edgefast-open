## source/porting/Kconfig.arch
```kconfig
# Copyright 2025 NXP
#
# SPDX-License-Identifier: BSD-3-Clause

config LITTLE_ENDIAN
	bool
	default y if MCUX_HW_DEVICE_MIMXRT1042 || \
			MCUX_HW_DEVICE_MIMXRT1062 || \
			MCUX_HW_DEVICE_MIMXRT685S || \
			MCUX_HW_DEVICE_MIMXRT1176 || \
			MCUX_HW_DEVICE_MIMXRT595S || \
			MCUX_HW_DEVICE_MIMXRT1052 || \
			MCUX_HW_DEVICE_MIMXRT1189 || \
			MCUX_HW_DEVICE_MIMXRT1187 || \
			MCUX_HW_DEVICE_MIMXRT1166 || \
			MCUX_HW_DEVICE_MIMXRT798S || \
			MCUX_HW_DEVICE_MIMXRT1152 || \
			MCUX_HW_DEVICE_MCXN547    || \
			MCUX_HW_DEVICE_MCXN947    || \
			MCUX_HW_DEVICE_MCXN947T   || \
			MCUX_HW_DEVICE_MIMXRT2663 || \
			MCUX_HW_DEVICE_RW612      || \
			MCUX_HW_DEVICE_RW610

config BIG_ENDIAN
	bool
	default y if !LITTLE_ENDIAN

menu "Atomic Operations"
config ATOMIC_OPERATIONS_BUILTIN
	bool
	help
	  Use the compiler builtin functions for atomic operations. This is
	  the preferred method. However, support for all arches in GCC is
	  incomplete.

config ATOMIC_OPERATIONS_ARCH
	bool
	help
	  Use when there isn't support for compiler built-ins, but you have
	  written optimized assembly code under arch/ which implements these.

config ATOMIC_OPERATIONS_C
	bool
	help
	  Use atomic operations routines that are implemented entirely
	  in C by locking interrupts. Selected by architectures which either
	  do not have support for atomic operations in their instruction
	  set, or haven't been implemented yet during bring-up, and also
	  the compiler does not have support for the atomic __sync_* builtins.
endmenu
```

## source/porting/Kconfig.dt.hci
```kconfig
# Copyright 2026 NXP
#
# SPDX-License-Identifier: BSD-3-Clause

config DT_CHOSEN_zephyr_bt_hci_EXISTS
	bool
	help
	  No prefix in generated macro

rsource "Kconfig.dt.hci.h4"
rsource "Kconfig.dt.hci.platform"
```

## source/porting/Kconfig.dt.hci.h4
```kconfig
# Copyright 2025 NXP
#
# SPDX-License-Identifier: BSD-3-Clause

config DT_HAS_ZEPHYR_BT_HCI_UART_ENABLED
	bool
	help
	  No prefix in generated macro

config DT_HAS_NXP_BT_HCI_UART_ENABLED
	bool
	select DT_HAS_ZEPHYR_BT_HCI_UART_ENABLED
	select DT_CHOSEN_zephyr_bt_hci_EXISTS
	help
	  No prefix in generated macro

if DT_HAS_NXP_BT_HCI_UART_ENABLED

config DT_N_INST_0_hci_uart_P_instance
	int "UART instance"
	default 2 if MCUX_HW_DEVICE_MIMXRT1176
	default 0
	help
	  No prefix in generated macro

config DT_N_INST_0_hci_uart_P_current_speed
	int "UART Current Speed"
	default 3000000 if MCUX_COMPONENT_component.wifi_bt_module.board_aw_am510_arduino
	default 115200
	help
	  Configure the default UART communication speed for Bluetooth HCI UART interface.
	  No prefix in generated macro

config DT_N_INST_0_nxp_bt_hci_uart_P_fw_download_primary_speed
	int "UART Primary Download Speed for firmware downloading"
	default 115200
	help
	  Configure the default UART communication speed for firmware downloading during the
	  primary stage.
	  No prefix in generated macro

config DT_N_INST_0_nxp_bt_hci_uart_P_fw_download_primary_speed_EXISTS
	bool
	default y
	help
	  No prefix in generated macro

config DT_N_INST_0_nxp_bt_hci_uart_P_fw_download_secondary_speed
	int "UART Secondary Download Speed for firmware downloading"
	default 3000000
	help
	  Configure the default UART communication speed for firmware downloading during the
	  secondary stage.
	  No prefix in generated macro

config DT_N_INST_0_nxp_bt_hci_uart_P_fw_download_secondary_speed_EXISTS
	bool
	default y
	help
	  No prefix in generated macro

config DT_N_INST_0_nxp_bt_hci_uart_P_hci_operation_speed
	int "UART HCI Operation Speed"
	default 3000000
	help
	  Configure the default UART communication speed for HCI operation.
	  No prefix in generated macro

config DT_N_INST_0_nxp_bt_hci_uart_P_hci_operation_speed_EXISTS
	bool
	default y
	help
	  No prefix in generated macro

config DT_N_INST_0_nxp_bt_hci_uart_P_hw_flow_control
	bool "UART Hardware Flow Control"
	default y
	help
	  Enable UART Hardware Flow Control for Bluetooth HCI UART interface.
	  No prefix in generated macro

config DT_N_INST_0_nxp_bt_hci_uart_P_hw_flow_control_EXISTS
	bool
	default y if DT_N_INST_0_nxp_bt_hci_uart_P_hw_flow_control
	help
	  No prefix in generated macro

config DT_N_INST_0_nxp_bt_hci_uart_P_fw_download_primary_flowcontrol
	bool "UART Primary Download Flow Control for firmware downloading"
	help
	  Configure the flow control settings for firmware downloading during the primary stage.
	  No prefix in generated macro

config DT_N_INST_0_nxp_bt_hci_uart_P_fw_download_primary_flowcontrol_EXISTS
	bool
	default y if DT_N_INST_0_nxp_bt_hci_uart_P_fw_download_primary_flowcontrol
	help
	  No prefix in generated macro

config DT_N_INST_0_nxp_bt_hci_uart_P_fw_download_secondary_flowcontrol
	bool "UART Secondary Download Flow Control for firmware downloading"
	default y
	help
	  Configure the flow control settings for firmware downloading during the secondary stage.
	  No prefix in generated macro

config DT_N_INST_0_nxp_bt_hci_uart_P_fw_download_secondary_flowcontrol_EXISTS
	bool
	default y if DT_N_INST_0_nxp_bt_hci_uart_P_fw_download_secondary_flowcontrol
	help
	  No prefix in generated macro

# sdio_reset_gpios
config DT_N_INST_0_nxp_bt_hci_uart_P_sdio_reset_gpios_EXISTS
	bool "SDIO reset GPIO"
	default n if MCUX_COMPONENT_component.wifi_bt_module.board_aw_am510_arduino
	default y
	help
	  No prefix in generated macro

config DT_N_INST_0_nxp_bt_hci_uart_P_sdio_reset_gpios_IDX_0_VAL_port
	int "SDIO reset GPIO port"
	default 3 if MCUX_HW_DEVICE_MCXN547
	default 3 if MCUX_HW_BOARD_mcxn9xxevk
	default 1 if MCUX_HW_BOARD_frdmmcxn947
	default 3 if MCUX_HW_DEVICE_MIMXRT1042
	default 1 if MCUX_HW_DEVICE_MIMXRT1052
	default 1 if MCUX_HW_DEVICE_MIMXRT1062
	default 9 if MCUX_HW_DEVICE_MIMXRT1176
	default 4 if MCUX_HW_DEVICE_MIMXRT1187 || MCUX_HW_DEVICE_MIMXRT1189
	default 2 if MCUX_HW_DEVICE_MIMXRT595S
	default 2 if MCUX_HW_DEVICE_MIMXRT685S
	default 7 if MCUX_HW_DEVICE_MIMXRT798S
	default 0
	help
	  No prefix in generated macro

config DT_N_INST_0_nxp_bt_hci_uart_P_sdio_reset_gpios_IDX_0_VAL_pin
	int "SDIO reset GPIO pin"
	default 5 if MCUX_HW_DEVICE_MCXN547
	default 5 if MCUX_HW_BOARD_mcxn9xxevk
	default 22 if MCUX_HW_BOARD_frdmmcxn947
	default 4 if MCUX_HW_DEVICE_MIMXRT1042
	default 19 if MCUX_HW_DEVICE_MIMXRT1052
	default 24 if MCUX_HW_DEVICE_MIMXRT1062
	default 15 if MCUX_HW_DEVICE_MIMXRT1176
	default 7 if MCUX_HW_DEVICE_MIMXRT1187 || MCUX_HW_DEVICE_MIMXRT1189
	default 10 if MCUX_HW_DEVICE_MIMXRT595S
	default 10 if MCUX_HW_DEVICE_MIMXRT685S
	default 23 if MCUX_HW_DEVICE_MIMXRT798S
	default 0
	help
	  No prefix in generated macro

config DT_N_INST_0_nxp_bt_hci_uart_P_sdio_reset_gpios_IDX_0_VAL_flags
	int "SDIO reset GPIO flags"
	default 1 if MCUX_HW_DEVICE_MCXN547
	default 1 if MCUX_HW_BOARD_mcxn9xxevk
	default 1 if MCUX_HW_BOARD_frdmmcxn947
	default 1 if MCUX_HW_DEVICE_MIMXRT1042
	default 1 if MCUX_HW_DEVICE_MIMXRT1052
	default 1 if MCUX_HW_DEVICE_MIMXRT1062
	default 1 if MCUX_HW_DEVICE_MIMXRT1176
	default 1 if MCUX_HW_DEVICE_MIMXRT1187 || MCUX_HW_DEVICE_MIMXRT1189
	default 1 if MCUX_HW_DEVICE_MIMXRT595S
	default 1 if MCUX_HW_DEVICE_MIMXRT685S
	default 1 if MCUX_HW_DEVICE_MIMXRT798S
	default 1
	help
	  No prefix in generated macro

# w_disable_gpios
config DT_N_INST_0_nxp_bt_hci_uart_P_w_disable_gpios_EXISTS
	bool "WIFI disable GPIO"
	default y
	help
	  No prefix in generated macro

config DT_N_INST_0_nxp_bt_hci_uart_P_w_disable_gpios_IDX_0_VAL_port
	int "WIFI disable GPIO port"
	default 0 if MCUX_HW_DEVICE_MCXN547
	default 0 if MCUX_HW_BOARD_mcxn9xxevk
	default 1 if MCUX_HW_BOARD_frdmmcxn947
	default 3 if MCUX_HW_DEVICE_MIMXRT1042
	default 1 if MCUX_HW_DEVICE_MIMXRT1052
	default 1 if MCUX_HW_DEVICE_MIMXRT1062
	default 9 if MCUX_HW_DEVICE_MIMXRT1176
	default 4 if MCUX_HW_DEVICE_MIMXRT1187 || MCUX_HW_DEVICE_MIMXRT1189
	default 0 if MCUX_HW_DEVICE_MIMXRT595S
	default 0 if MCUX_HW_DEVICE_MIMXRT685S
	default 3 if MCUX_HW_DEVICE_MIMXRT798S
	default 0
	help
	  No prefix in generated macro

config DT_N_INST_0_nxp_bt_hci_uart_P_w_disable_gpios_IDX_0_VAL_pin
	int "WIFI disable GPIO pin"
	default 8 if MCUX_HW_DEVICE_MCXN547
	default 8 if MCUX_HW_BOARD_mcxn9xxevk
	default 21 if MCUX_HW_BOARD_frdmmcxn947
	default 2 if MCUX_HW_DEVICE_MIMXRT1042
	default 26 if MCUX_HW_DEVICE_MIMXRT1052
	default 19 if MCUX_HW_DEVICE_MIMXRT1062
	default 31 if MCUX_HW_DEVICE_MIMXRT595S
	default 12 if MCUX_HW_DEVICE_MIMXRT685S
	default 7 if MCUX_HW_DEVICE_MIMXRT798S
	default 30 if MCUX_HW_DEVICE_MIMXRT1176
	default 17 if MCUX_HW_DEVICE_MIMXRT1187 || MCUX_HW_DEVICE_MIMXRT1189
	default 0
	help
	  No prefix in generated macro

config DT_N_INST_0_nxp_bt_hci_uart_P_w_disable_gpios_IDX_0_VAL_flags
	int "WIFI disable GPIO flags"
	default 1 if MCUX_HW_DEVICE_MCXN547
	default 1 if MCUX_HW_BOARD_mcxn9xxevk
	default 1 if MCUX_HW_BOARD_frdmmcxn947
	default 1 if MCUX_HW_DEVICE_MIMXRT1042
	default 1 if MCUX_HW_DEVICE_MIMXRT1052
	default 1 if MCUX_HW_DEVICE_MIMXRT1062
	default 1 if MCUX_HW_DEVICE_MIMXRT595S
	default 1 if MCUX_HW_DEVICE_MIMXRT685S
	default 1 if MCUX_HW_DEVICE_MIMXRT798S
	default 1 if MCUX_HW_DEVICE_MIMXRT1176
	default 1 if MCUX_HW_DEVICE_MIMXRT1187 || MCUX_HW_DEVICE_MIMXRT1189
	default 1
	help
	  No prefix in generated macro

endif # DT_HAS_NXP_BT_HCI_UART_ENABLED
```

## source/porting/Kconfig.dt.hci.platform
```kconfig
# Copyright 2025 NXP
#
# SPDX-License-Identifier: BSD-3-Clause

config DT_HAS_NXP_HCI_BLE_ENABLED
	bool
	select DT_CHOSEN_zephyr_bt_hci_EXISTS
	help
	  No prefix in generated macro

if DT_HAS_NXP_HCI_BLE_ENABLED

endif # DT_HAS_NXP_HCI_BLE_ENABLED
```

## source/porting/Kconfig.freertos
```kconfig
# Copyright 2025 NXP
#
# SPDX-License-Identifier: BSD-3-Clause

config NUM_PREEMPT_PRIORITIES
	int "Number of Preemption Priorities"
	default 12
	range 2 16
	help
	  Configure the number of preemption priority levels for Bluetooth stack scheduling

config USE_STATS_FORMATTING_FUNCTIONS
	bool "Enable Statistics Formatting Functions"
	help
	  Enable Statistics Formatting Functions

config TOTAL_HEAP_SIZE_KB
	int "Total Heap Size (KB)"
	default 64
	range 12 512
	help
	  Configure the total heap size in kilobytes for FreeRTOS memory allocation
```

## source/porting/Kconfig.logging
```kconfig
# Copyright 2025 NXP
#
# SPDX-License-Identifier: BSD-3-Clause

config LOG
	bool "Bluetooth LOG Configuration"
	default n
	help
	  Enable LOG features for Bluetooth stack

config BT_LOGGING
	bool "Bluetooth Debug Configuration"
	default BT_LOG
	help
	  Enable debug features and logging for Bluetooth stack

config BT_LOGGING_ASYNC
	bool "Bluetooth Logging ASYNC Mode"
	depends on BT_LOGGING
	help
	  Configure Bluetooth logging async mode

config BT_LOGGING_INIT_PRIORITY
	int "Bluetooth Logging Initialization Priority"
	depends on BT_LOGGING
	default 50
	range 0 255
	help
	  Configure Bluetooth logging initialization priority

config BT_DEFAULT_LOG_LEVEL
	int "Bluetooth Default Log Level"
	depends on BT_LOGGING
	default 4
	range 0 6
	help
	  Configure logging verbosity for Bluetooth stack initialization and core configuration

config BT_LOGGING_USBCDC
	bool "Bluetooth logging via USBCDC"
	depends on BT_LOGGING
	help
	  Enable logging via USBCDC for Bluetooth stack

config LOG_RUNTIME_FILTERING
	bool "Runtime filtering reconfiguration"
	depends on !LOG_MODE_MINIMAL
	help
	  Allow runtime configuration of maximal, independent severity
	  level for instance.

config LOG_DEFAULT_MINIMAL
	bool
```

## source/porting/Kconfig.low_power
```kconfig
# Copyright 2025 NXP
#
# SPDX-License-Identifier: BSD-3-Clause

# low power component
config MCUX_COMPONENT_middleware.edgefast_open.low_power
    bool "Low power"
    depends on MCUX_HW_DEVICE_MIMXRT595S || MCUX_HW_DEVICE_RW612 || MCUX_HW_DEVICE_RW610
    select MCUX_COMPONENT_middleware.edgefast_open.host_low_power

config MCUX_COMPONENT_middleware.edgefast_open.host_low_power
    bool
    select MCUX_COMPONENT_middleware.wireless.framework
    select MCUX_COMPONENT_middleware.wireless.framework.lowpower

config MCUX_COMPONENT_middleware.edgefast_open.controller_low_power
    bool
    default y if MCUX_COMPONENT_middleware.edgefast_open.low_power && !MCUX_HW_DEVICE_RW612 && !MCUX_HW_DEVICE_RW610
```

## source/porting/Kconfig.suppress
```kconfig
# Copyright 2026 NXP
#
# SPDX-License-Identifier: BSD-3-Clause

config EDGEFAST_OPEN_SUPPRESSED_WARNINGS
	bool "Suppress compiler warnings for EdgeFast Open stack"
	default y
	help
	  Suppress compiler warnings for EdgeFast Open stack
```

## source/porting/Kconfig.toolchain
```kconfig
# Copyright 2025 NXP
#
# SPDX-License-Identifier: BSD-3-Clause

config SUPPRESSED_WARNINGS
	bool "Suppress Compilation Warnings"
	default y

config EDGEFAST_OPEN_NO_UNALIGNED_ACCESS
	bool "Disable unaligned memory access"
	default n
	help
	  Prevent the compiler from generating unaligned memory accesses for the
	  EdgeFast Open stack. Enable this on targets that do not support unaligned
	  access or where such accesses cause faults or performance penalties.
```

## source/porting/Kconfig.warning
```kconfig
# Copyright 2026 NXP
#
# SPDX-License-Identifier: BSD-3-Clause

config MINIMAL_LIBC_STRING_ERROR_TABLE
	bool "String error table for strerror() and strerror_r()"
	help
	  Select this option to ensure that strerror(), strerror_r()
	  produce strings corresponding to the descriptions in errno.h.

	  The string error table can add ~2kiB to ROM. As such, it is
	  disabled by default. In this case, strerror() and strerror_r()
	  symbols are still present, but the functions produce an empty
	  string.

config TEST
	bool "Mark project as a test"
	# For tests, store thread names in binary and dump them on crash to
	# ease debugging.
	select THREAD_NAME
	help
	  Mark a project or an application as a test. This will enable a few
	  test defaults.

config TEST_LOGGING_DEFAULTS
	bool "Test case logging defaults"
	depends on TEST
	select LOG
	select LOG_DEFAULT_MINIMAL
	default y
	help
	  Option which implements default policy of enabling logging in
	  minimal mode for all test cases. For tests that need alternate
	  logging configuration, or no logging at all, disable this
	  in the project-level defconfig.
```

## source/porting/reboot/Kconfig
```kconfig
# Copyright 2025 NXP
#
# SPDX-License-Identifier: BSD-3-Clause

config BT_REBOOT_WDOG
	bool "reboot wdog support"
	imply MCUX_COMPONENT_driver.wdog01
	default y if MCUX_HW_DEVICE_MIMXRT1176
```
