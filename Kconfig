## Kconfig
```kconfig
# Copyright 2025 NXP
#
# SPDX-License-Identifier: BSD-3-Clause

menu "Edgefast Open Bluetooth Configurations(edgefast_open_config.h)"

menuconfig MCUX_COMPONENT_middleware.edgefast_open
	bool "Edgefast Open Bluetooth Host Stack"
	imply MCUX_COMPONENT_middleware.freertos-kernel
	imply MCUX_COMPONENT_component.osa
	imply FSL_OSA_TASK_ENABLE
	imply MCUX_COMPONENT_utility.assert
	imply MCUX_COMPONENT_component.log
	imply MCUX_COMPONENT_component.log.backend.debug_console
	select MCUX_PRJSEG_utility.debug_console_transfer_non_blocking
	select BT
	select UTF8
	select MCUX_COMPONENT_middleware.mbedtls if MCUX_HW_DEVICE_MIMXRT1042 || \
						MCUX_HW_DEVICE_MIMXRT685S || \
						MCUX_HW_DEVICE_MIMXRT595S || \
						MCUX_HW_DEVICE_MIMXRT1189 || \
						MCUX_HW_DEVICE_MIMXRT1187 || \
						MCUX_HW_DEVICE_MIMXRT1166 || \
						MCUX_HW_DEVICE_MCXN547    || \
						MCUX_HW_DEVICE_MCXN947    || \
						MCUX_HW_DEVICE_RW612
	select MCUX_COMPONENT_middleware.mbedtls3x if MCUX_HW_DEVICE_MIMXRT1176 || \
						MCUX_HW_DEVICE_MIMXRT1052 || \
						MCUX_HW_DEVICE_MIMXRT1062 || \
						MCUX_HW_DEVICE_MIMXRT798S
	select BT_CRYPTO_PSA if MCUX_HW_DEVICE_MIMXRT1176 || \
				MCUX_HW_DEVICE_MIMXRT1052 || \
				MCUX_HW_DEVICE_MIMXRT1062 || \
				MCUX_HW_DEVICE_MIMXRT798S
	select ATOMIC_OPERATIONS_BUILTIN

if MCUX_COMPONENT_middleware.edgefast_open

# Load Kconfig.defconfig firstly
rsource "Kconfig.defconfig"

rsource "Kconfig.ecosystem"
rsource "Kconfig.ecosystem.compress"

rsource "./*/Kconfig"

endif # MCUX_COMPONENT_middleware.edgefast_open

endmenu
```

## Kconfig.defconfig
```kconfig
# Copyright 2025 NXP
#
# SPDX-License-Identifier: BSD-3-Clause

config BT_RX_STACK_SIZE
	default 4096
	range 4096 65536

config EDGEFAST_OPEN_NO_UNALIGNED_ACCESS
	default y if MCUX_HW_DEVICE_RW612

if BT_LONG_WQ
config BT_LONG_WQ_STACK_SIZE
	default 4096 if MCUX_HW_DEVICE_MCXN547
	default 4096 if MCUX_HW_DEVICE_MCXN947
	default 4096 if MCUX_HW_DEVICE_MCXN947T
	default 4096 if MCUX_HW_DEVICE_RW612
	default 3072

config BT_LONG_WQ_PRIO
	range 0 NUM_PREEMPT_PRIORITIES

endif # BT_LONG_WQ

config SYSTEM_WORKQUEUE_PRIORITY
	range 0 NUM_PREEMPT_PRIORITIES

config BT_RX_PRIO
	range 0 NUM_PREEMPT_PRIORITIES
	default 9

config BT_HCI_TX_PRIO
	range 0 NUM_PREEMPT_PRIORITIES

config BT_CONN_TX_NOTIFY_WQ_PRIO
	range 0 NUM_PREEMPT_PRIORITIES

config BT_DRIVER_RX_HIGH_PRIO
	range 0 NUM_PREEMPT_PRIORITIES

config BT_MPL_MEDIA_PLAYER_NAME
	help
	  Macro value is in quotes

config BT_MPL_ICON_URL
	help
	  Macro value is in quotes

config BT_DEBUG_MONITOR_RTT_BUFFER_NAME
	help
	  Macro value is in quotes

config BT_DEVICE_NAME
	help
	  Macro value is in quotes

config BT_OTS_DIR_LIST_OBJ_NAME
	help
	  Macro value is in quotes

config BT_DIS_MODEL_NUMBER_STR
	help
	  Macro value is in quotes

config BT_DIS_MODEL
	help
	  Macro value is in quotes

config BT_DIS_MANUF_NAME_STR
	help
	  Macro value is in quotes

config BT_DIS_MANUF
	help
	  Macro value is in quotes

config BT_DIS_SERIAL_NUMBER_STR
	help
	  Macro value is in quotes

config BT_DIS_FW_REV_STR
	help
	  Macro value is in quotes

config BT_DIS_HW_REV_STR
	help
	  Macro value is in quotes

config BT_DIS_SW_REV_STR
	help
	  Macro value is in quotes

config BT_DIS_UDI_LABEL_STR
	help
	  Macro value is in quotes

config BT_DIS_UDI_DI_STR
	help
	  Macro value is in quotes

config BT_DIS_UDI_ISSUER_STR
	help
	  Macro value is in quotes

config BT_DIS_UDI_AUTHORITY_STR
	help
	  Macro value is in quotes

config BT_DIS_IEEE_RCDL_STR
	help
	  Macro value is in quotes

config BT_OTS_DIR_LIST_OBJ_NAME
	help
	  Macro value is in quotes
```

## examples/a2dp_sink/Kconfig
```kconfig
#
# Copyright 2025 NXP
#
# SPDX-License-Identifier: Apache-2.0
#

mainmenu "Bluetooth: A2DP Sink"

config A2DP_SBC_PCM_BUFFER_PLAY_COUNT
	int "The buffer count that every size is 480*2*2 bytes"
	default 50

config A2DP_BOARD_CODEC_PLAY_COUNT
	int "The play count of the board codec interface (i2s)"
	default 4

config A2DP_BOARD_CODEC_PLAY_THRESHOLD
	int "The threshold of pcm buffer when playing data to codec (n%)"
	default 20

source "Kconfig.mcuxpresso"
```

## examples/handsfree_ag/Kconfig
```kconfig
source "middleware/edgefast_open/Kconfig"
source "Kconfig.mcuxpresso"

config HANDSFREE_BT_PCM_TO_CODEC_DIRECT
	bool "Enable direct PCM routing from BT module to codec"
	default y if MCUX_HW_BOARD_frdmimxrt1152
	default n
	help
	  Enable direct hardware PCM routing from Bluetooth module
	  to codec, bypassing the application layer processing.
	  This reduces latency and CPU overhead for SCO audio data.
```

## examples/map_mce/Kconfig
```kconfig
#
# Copyright 2025 NXP
#
# SPDX-License-Identifier: Apache-2.0
#

mainmenu "Bluetooth: MAP MCE"

config BT_MAP_MCE_DISCOVER_RESULT_COUNT
	int "Maximum result count per device discovery"
	default 10

config BT_MAP_MCE_SUPPORTED_FEATURES
	hex "MCE supported features"
	default 0x0077FFFF

config BT_MAP_MCE_MAS_DATA_BUF_SIZE
	int "MCE MAS data buffer size (bytes)"
	default BT_GOEP_RFCOMM_MTU

config BT_MAP_MCE_MAS_DATA_BUF_COUNT
	int "MCE MAS data buffer count"
	default 1

config BT_MAP_MCE_MNS_DATA_BUF_SIZE
	int "MCE MNS data buffer size (bytes)"
	default BT_GOEP_RFCOMM_MTU

config BT_MAP_MCE_MNS_DATA_BUF_COUNT
	int "MCE MNS data buffer count"
	default 1

config BT_MAP_MCE_NAME_MAX_LEN
	int "Maximum name length"
	default 17
	range 17 255
	help
	  The minimal value is 17 to accommodate the longest message handle.

config BT_MAP_MCE_TEST_PHONE_NUMBER
	string "Test phone number"
	default "\"0123456789\""

source "Kconfig.mcuxpresso"
```

## examples/map_mse/Kconfig
```kconfig
#
# Copyright 2025 NXP
#
# SPDX-License-Identifier: Apache-2.0
#

mainmenu "Bluetooth: MAP MSE"

config BT_MAP_MSE_DISCOVER_RESULT_COUNT
	int "Maximum result count per device discovery"
	default 10

config BT_MAP_MSE_MAS_INSTANCE_ID
	hex "MSE MAS instance ID"
	default 0

config BT_MAP_MSE_SUPPORTED_FEATURES
	hex "MSE supported features"
	default 0x007FFFFF

config BT_MAP_MSE_SUPPORTED_MSG_TYPES
	hex "MSE supported message types"
	default 0x1F

config BT_MAP_MSE_MAS_DATA_BUF_SIZE
	int "MSE MAS data buffer size (bytes)"
	default BT_GOEP_RFCOMM_MTU

config BT_MAP_MSE_MAS_DATA_BUF_COUNT
	int "MSE MAS data buffer count"
	default 1

config BT_MAP_MSE_MNS_DATA_BUF_SIZE
	int "MSE MNS data buffer size (bytes)"
	default BT_GOEP_RFCOMM_MTU

config BT_MAP_MSE_MNS_DATA_BUF_COUNT
	int "MSE MNS data buffer count"
	default 1

config BT_MAP_MSE_MAS_MSGQ_COUNT
	int "MSE MAS message queue count"
	default 3

config BT_MAP_MSE_MNS_MSGQ_COUNT
	int "MSE MNS message queue count"
	default 2

config BT_MAP_MSE_PATH_MAX_LEN
	int "Maximum path length"
	default 45
	range 45 65535
	help
	  The minimal value is 45 to accommodate
	  the longest path(0:/root/telecom/msg/deleted/) and message handle.

config BT_MAP_MSE_NAME_MAX_LEN
	int "Maximum name length"
	default 17
	range 17 255
	help
	  The minimal value is 17 to accommodate the longest message handle.

source "middleware/edgefast_open/Kconfig"
source "Kconfig.mcuxpresso"
```

## examples/pbap_pse/Kconfig
```kconfig
mainmenu "Bluetooth: PBAP PSE"

config BT_PBAP_PSE_DISCOVER_RESULT_COUNT
	int "Maximum result count per device discovery"
	default 10

config BT_PBAP_PSE_RFCOMM_CHANNEL
        int "RFCOMM channel for PBAP PSE"
        default 3

config BT_PBAP_PSE_L2CAP_PSM
        hex "L2CAP PSM for PBAP PSE"
        default 0x1009

config BT_PBAP_PSE_SUPPORTED_REPOSITORIES
        hex "Supported repositories bitmask for PBAP PSE"
        default 0xf

config BT_PBAP_PSE_SUPPORTED_FEATURES
	hex "Supported features bitmask for PBAP PSE"
        default 0x3ff

config BT_PBAP_PSE_DATA_SEND_TASK_STACK_SIZE
	int "Stack size for PSE data send task"
	default 1024

source "Kconfig.mcuxpresso"
```

## examples/shell/Kconfig
```kconfig
source "middleware/edgefast_open/Kconfig"
source "Kconfig.mcuxpresso"

config BT_NXP_DTM
	bool "NXP Bluetooth Direct Test Mode shell commands"
	depends on BT_NXP
	depends on BT_SHELL
	help
	  Enable NXP-specific BLE and BR/EDR Direct Test Mode (DTM) shell commands for
	  use with NXP external HCI controllers. Provides two command groups:
	    le_test  - LE Enhanced TX/RX test and NXP VS TX power config
	    bt_test  - BR/EDR NXP VS TX/RX test and DUT mode (CONFIG_BT_CLASSIC)
```

## lib/asrc_sw/Kconfig
```kconfig
# Copyright (c) 2025 NXP
# SPDX-License-Identifier: Apache-2.0

config ZEPHYR_ASRC_SW_MODULE
	bool

config ASRC_SW
	bool "ASRC_SW Support"
	help
	  This option enables ASRC SW (Asynchronous Sample Rate Converter Software)
```

## lib/liblc3/Kconfig
```kconfig
# Copyright (c) 2025 NXP
# SPDX-License-Identifier: Apache-2.0

config ZEPHYR_LIBLC3_MODULE
	bool

config LIBLC3
	bool "liblc3 Support"
	help
	  This option enables Low Complexity Communication Codec (LC3)
```

## lib/utils/Kconfig
```kconfig
# Copyright (c) 2016 Intel Corporation
# SPDX-License-Identifier: Apache-2.0

config UTF8
	bool "UTF-8 string operation supported"
	help
	  Enable the utf8 API. The API implements functions to specifically
	  handle UTF-8 encoded strings.

config GETOPT
	bool "Getopt library support"
	help
	  This option adds support of the sys_getopt API.

config GETOPT_LONG
	bool "Getopt long library support"
	depends on GETOPT
	help
	  This option adds support of the getopt long.
	  Different shell backends are using their own instance of getopt to
	  not interfere with each other.
	  All not shell threads share one global instance of getopt state, hence
	  apart from shell this library is not thread safe. User can add support
	  for other threads by extending function sys_getopt_state_get in
	  getopt_common.c file.
```

## source/bluetooth/controller/Kconfig
```kconfig
# Copyright 2025 NXP
#
# SPDX-License-Identifier: BSD-3-Clause

menuconfig MCUX_COMPONENT_middleware.edgefast_open.hci
	bool "Edgeafast Open Bluetooth HCI Configuration"
	default y
	help
	  The HCI (Host Controller Interface) configuration for Edgefast Open Bluetooth stack

if MCUX_COMPONENT_middleware.edgefast_open.hci

rsource "./*/Kconfig"

choice MCUX_COMPONENT_middleware.edgefast_open.hci.transport
	prompt "Bluetooth HCI Transport Method"
	default MCUX_COMPONENT_middleware.edgefast_open.hci.transport.platform if MCUX_HW_DEVICE_RW612
	default MCUX_COMPONENT_middleware.edgefast_open.hci.transport.h4
	help
	  Select the transport method for Bluetooth Host Controller Interface

config MCUX_COMPONENT_middleware.edgefast_open.hci.transport.h4
	bool "H4 UART Transport"
	depends on MCUX_HW_DEVICE_MIMXRT1042 || MCUX_HW_DEVICE_MIMXRT1062 || \
		MCUX_HW_DEVICE_MIMXRT685S || MCUX_HW_DEVICE_MIMXRT1176 || \
		MCUX_HW_DEVICE_MIMXRT595S || MCUX_HW_DEVICE_MIMXRT1052 || \
		MCUX_HW_DEVICE_MIMXRT1189 || MCUX_HW_DEVICE_MIMXRT1187 || \
		MCUX_HW_DEVICE_MIMXRT1166 || MCUX_HW_DEVICE_MCXN547 || \
		MCUX_HW_DEVICE_MCXN947    || MCUX_HW_DEVICE_MIMXRT798S
	select DT_HAS_NXP_BT_HCI_UART_ENABLED
	select MCUX_COMPONENT_component.serial_manager
	select MCUX_COMPONENT_component.serial_manager_uart
	select MCUX_COMPONENT_driver.lpuart_edma if MCUX_HAS_COMPONENT_driver.lpuart_edma
	select MCUX_COMPONENT_driver.lpflexcomm_lpuart_edma if MCUX_HAS_COMPONENT_driver.lpflexcomm_lpuart_edma
	select MCUX_COMPONENT_driver.flexcomm_usart_dma if MCUX_HAS_COMPONENT_driver.flexcomm_usart_dma
	select MCUX_COMPONENT_component.igpio_adapter if MCUX_HAS_COMPONENT_driver.igpio
	select MCUX_COMPONENT_component.rt_gpio_adapter if MCUX_HAS_COMPONENT_driver.lpc_gpio
	select MCUX_COMPONENT_component.rgpio_adapter if MCUX_HAS_COMPONENT_driver.rgpio
	select MCUX_COMPONENT_component.gpio_adapter if MCUX_HAS_COMPONENT_driver.gpio
	select MCUX_COMPONENT_middleware.wifi.fwdnld
	select MCUX_COMPONENT_middleware.wifi.osa_free_rtos
	select MCUX_COMPONENT_middleware.sdmmc.host.usdhc
	select MCUX_COMPONENT_middleware.sdmmc.sdio
	select MCUX_COMPONENT_middleware.edgefast_open.controller.lwip.config if !MCUX_COMPONENT_middleware.lwip
	select MCUX_COMPONENT_middleware.edgefast_open.controller.wifi.config if !MCUX_COMPONENT_middleware.wifi
	select BT_IND_DNLD if !BT_BYPASS_DOWNLOAD
	select BT_ONLY_DNLD if !BT_BYPASS_DOWNLOAD

config MCUX_COMPONENT_middleware.edgefast_open.hci.transport.platform
	bool "Platform Transport"
	depends on MCUX_HW_DEVICE_RW612

endchoice # MCUX_COMPONENT_middleware.edgefast_open.hci.transport

config BT_IND_DNLD
	bool "Bluetooth Independent Firmware Download (Bluetooth Firmware Only)"
	default n

config BT_ONLY_DNLD
	bool "Bluetooth Independent Firmware Download (Bluetooth Firmware Only)"
	default n

config BT_BYPASS_DOWNLOAD
	bool "Bypass Bluetooth Firmware Download"
	default n

# choice BT_CONTROLLER
# 	prompt "Bluetooth Controller Selection"
# 	default BT_CONTROLLER_MURATA_2EL_M2

# config BT_CONTROLLER_MURATA_2EL_M2
# 	bool "Murata 2EL M.2 Bluetooth Controller"
# 	default y if MCUX_COMPONENT_component.wifi_bt_module.board_murata_2el_m2
# 	depends on MCUX_COMPONENT_middleware.edgefast_open.hci.transport.h4
# 	help
# 	  Select Murata 2EL M.2 form factor Bluetooth controller

# config BT_CONTROLLER_RW612
# 	bool "RW612 Bluetooth Controller"
# 	default y if MCUX_COMPONENT_component.wifi_bt_module.RW61X
# 	depends on MCUX_COMPONENT_middleware.edgefast_open.hci.transport.platform
# 	help
# 	  Select Murata 2EL M.2 form factor Bluetooth controller

# endchoice #BT_CONTROLLER

endif # MCUX_COMPONENT_middleware.edgefast_open.hci
```

## source/bluetooth/controller/hci/configs/wifi/Kconfig
```kconfig
# Copyright 2025 NXP
#
# SPDX-License-Identifier: BSD-3-Clause

config MCUX_COMPONENT_middleware.edgefast_open.controller.wifi.config
    bool
```

## source/bluetooth/crypto/Kconfig
```kconfig
# Copyright (c) 2022 Nordic Semiconductor ASA
# SPDX-License-Identifier: Apache-2.0

config BT_CRYPTO
	bool
	select MBEDTLS if !BUILD_WITH_TFM
	select MBEDTLS_PSA_CRYPTO_C if !BUILD_WITH_TFM
	select PSA_WANT_KEY_TYPE_AES
	select PSA_WANT_ALG_CMAC
	select PSA_WANT_ALG_ECB_NO_PADDING
	imply MBEDTLS_AES_ROM_TABLES if MBEDTLS_PSA_CRYPTO_C
	help
	  This option enables the Bluetooth Cryptographic Toolbox.

config PSA_CRYPTO
	bool "PSA Crypto Support"
	help
	  Enable support for PSA (Platform Security Architecture) Crypto

config BT_CRYPTO_PSA
	bool "PSA Crypto Support for Bluetooth"
	depends on BT_CRYPTO
	help
	  This option enables PSA Crypto API support for Bluetooth cryptographic operations.

config PSA_CRYPTO_CLIENT
	bool
	default y
	help
	  Enable support for PSA (Platform Security Architecture) Crypto Client
```

## source/bluetooth/services/Kconfig.fmp
```kconfig
# Bluetooth GATT Find Me Service

# Copyright 2025 NXP
# SPDX-License-Identifier: Apache-2.0

config BT_FMP
	bool "GATT Find Me service"
```

## source/bluetooth/services/Kconfig.fms
```kconfig
# Bluetooth GATT Find Me Service

# Copyright 2025 NXP
# SPDX-License-Identifier: Apache-2.0

config BT_FMS
	bool "GATT Find Me service"
```

## source/bluetooth/services/Kconfig.hps
```kconfig
# Bluetooth GATT HTTP Proxy Service

# Copyright 2025 NXP
# SPDX-License-Identifier: Apache-2.0

config BT_HPS
	bool "GATT HTTP Proxy Service"
```

## source/bluetooth/services/Kconfig.hts
```kconfig
# Bluetooth GATT Health Thermometer Service

# Copyright 2025 NXP
# SPDX-License-Identifier: Apache-2.0

config BT_HTS
	bool "GATT Health Thermometer Service"
```

## source/bluetooth/services/Kconfig.ipsp
```kconfig
# Bluetooth GATT IPSP Service

# Copyright 2025 NXP
# SPDX-License-Identifier: Apache-2.0

config BT_IPSP
	bool "GATT IPSP Service"
```

## source/bluetooth/services/Kconfig.pxr
```kconfig
# Bluetooth GATT Proximity Service

# Copyright 2025 NXP
# SPDX-License-Identifier: Apache-2.0

config BT_PXR
	bool "GATT Proximity service"
```

## source/bluetooth/services/Kconfig.tip
```kconfig
# Bluetooth GATT Time Service

# Copyright 2025 NXP
# SPDX-License-Identifier: Apache-2.0

config BT_TIP
	bool "GATT Time service"
```

## source/bluetooth/services/Kconfig.wus
```kconfig
# Bluetooth GATT Wireless UART Service

# Copyright 2025 NXP
# SPDX-License-Identifier: Apache-2.0

config BT_WUS
	bool "GATT Wireless UART service"
```
