## source/porting/Kconfig
```kconfig
# Copyright 2025 NXP
#
# SPDX-License-Identifier: BSD-3-Clause

rsource "Kconfig.dt"
rsource "Kconfig.arch"
rsource "Kconfig.toolchain"
rsource "Kconfig.assert"
rsource "Kconfig.freertos"
rsource "Kconfig.logging"
rsource "Kconfig.suppress"

rsource "./*/Kconfig"

config SYSTEM_WORKQUEUE_STACK_SIZE
	int "System Workqueue Stack Size"
	default 8192 if BT_CRYPTO_PSA
	default 4096
	help
	  Configure the stack size for the system workqueue used in Bluetooth stack processing

config SYSTEM_WORKQUEUE_PRIORITY
	int "System Workqueue Priority"
	default 8
	range 0 NUM_PREEMPT_PRIORITIES
	help
	  Configure the priority level for the system workqueue used in Bluetooth stack processing

config PRINTK
	bool "Bluetooth Printing Configuration"
	default y
	help
	  Enable printing functionality

config KERNEL_INIT_PRIORITY_DEVICE
	int
	default 50

config ZTEST
	bool "Bluetooth testing"
	help
	  Enable Bluetooth testing

config SEGGER_RTT_MAX_NUM_UP_BUFFERS
	int "Segger RTT max number of up buffers"
	default 10
	help
	  Configure the maximum number of up buffers for Segger RTT
	  It is used to fix Kconfig warning.

config APPLICATION_INIT_PRIORITY
	int "Default init priority for application level drivers"
	default 90
	help
	  This priority level is for end-user drivers such as sensors and display
	  which have no inward dependencies.

config KERNEL_INIT_PRIORITY_DEFAULT
	int "Default init priority"
	default 40
	help
	  Default minimal init priority for each init level.

config RING_BUFFER
	bool "Ring buffers"
	help
	  Provide highly efficient ring buffer management for arbitrary data.
	  Some facilities such as kernel pipes are built on top of this.
	  May be used directly e.g. when the pipe overhead is unnecessary.

config RING_BUFFER_LARGE
	bool "Allow large ring buffer sizes"
	depends on RING_BUFFER
	help
	  Increase maximum buffer size from 32KB to 2GB. When this is enabled,
	  all struct ring_buf instances become 12 bytes bigger.
```
